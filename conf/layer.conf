## conf/layer.conf
```bitbake
# We have a conf and classes directory, add to BBPATH
BBPATH .= ":${LAYERDIR}"

# We have recipes-* directories, add to BBFILES
BBFILES += "${LAYERDIR}/recipes-*/*/*.bb \
            ${LAYERDIR}/recipes-*/*/*.bbappend"

BBFILE_COLLECTIONS += "meta-rpi-diya"
BBFILE_PATTERN_meta-rpi-diya = "^${LAYERDIR}/"
BBFILE_PRIORITY_meta-rpi-diya = "11"

LAYERDEPENDS_meta-rpi-diya = "core raspberrypi"
LAYERSERIES_COMPAT_meta-rpi-diya = "mickledore"

PACKAGE_CLASSES = "package_ipk"
INHERIT += "rm_work"

EXTRA_IMAGE_FEATURES ?= " ssh-server-dropbear read-only-rootfs "
# ssh-server-dropbear
DISTRO_FEATURES:append := " vc4-gfx opengl "
DISTRO_FEATURES:remove = " x11 wayland vulkan "
TOOLCHAIN_TARGET_TASK:append = " libgles3-mesa-dev "
# DISTRO_FEATURES:append := " vc4-gfx opengl directfb "
MACHINE ?= "raspberrypi0-2w-64"

WKS_FILE="rpi.wks.in"
ROOT_HOME = "/root"

#MACHINE = "raspberrypi3-64"
#MACHINE = "raspberrypi2"

#RPI_USE_U_BOOT:raspberrypi = "0"
RPI_USE_U_BOOT = "0"
RPI_USE_wS_28_DPI_LCD = "1"
# enable usb boot in uboot
ENABLE_DWC2_PERIPHERAL = "1"
ENABLE_DWC2_HOST = "1"
ENABLE_USB_U_BOOT = "0"
ENABLE_UART = "0"
DISABLE_SPLASH = "1"
VIDEO_CAMERA = "1"
DISABLE_RPI_BOOT_LOGO = "1"
ENABLE_SPI_BUS = "0"
ENABLE_I2C = "0"
KERNEL_MODULE_AUTOLOAD:rpi += " i2c-dev "

VC4DTBO = "vc4-kms-v3d,noaudio"

KERNEL_DEVICETREE:append = " overlays/vc4-kms-dpi-generic.dtbo overlays/dpi24.dtbo "


RPI_EXTRA_CONFIG += "${@['','\n\
dtoverlay=vc4-kms-dpi-generic \n\
dtparam=hactive=480,hfp=26,hsync=16,hbp=10 \n\
dtparam=vactive=640,vfp=25,vsync=10,vbp=15 \n\
dtparam=clock-frequency=32000000 \n\
dtparam=hsync-invert,vsync-invert,pixclk-invert \n\
dtparam=rgb666-padhi,rotate=270 \n\
dtoverlay=waveshare-28dpi-3b-4b \n\
dtoverlay=waveshare-28dpi-3b \n\
dtoverlay=waveshare-28dpi-4b \n']['${RPI_USE_wS_28_DPI_LCD}' == '1']}"

RPI_EXTRA_CONFIG += '\n\
# enable ads1115 sensor for battery monitoring \n\
dtoverlay=ads1115-i2c-gpio,cha_enable,cha_cfg=4,cha_datarate=7,cha_gain=1 \n\
#start_x=1             # essential \n\
#gpu_mem=128           # at least, or maybe more if you wish \n\
#disable_camera_led=1  # optional \n\
'

# extra kernel CMDLINE_RNDIS option
# CMDLINE_RNDIS += " video=DPI-1:480x640,rotate=90 "
# accept license for wifi and bluetooth firmware
LICENSE_FLAGS_ACCEPTED = "synaptics-killswitch"
```
